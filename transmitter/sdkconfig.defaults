## transmitter/sdkconfig.defaults
```kconfig
CONFIG_ESPTOOLPY_MONITOR_BAUD=921600
CONFIG_ESP_CONSOLE_UART_BAUDRATE=921600
CONFIG_MONITOR_BAUD=921600
CONFIG_CONSOLE_UART_BAUDRATE=921600

CONFIG_FREERTOS_HZ=1000

# Heap-leak / corruption sanity nets used by the test harness.
# Disable the existing _DISABLED default explicitly so the override sticks.
CONFIG_HEAP_POISONING_DISABLED=n
CONFIG_HEAP_POISONING_LIGHT=y
CONFIG_HEAP_TASK_TRACKING=y
```
